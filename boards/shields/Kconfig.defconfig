## boards/shields/Kconfig.defconfig
```kconfig
# Copyright (c) 2025 The ZMK Contributors
# SPDX-License-Identifier: MIT

if SHIELD_lux_ergo

config ZMK_KEYBOARD_NAME
  default "Lux_Ergo"

endif
```

## boards/shields/Kconfig.shield
```kconfig
# Copyright (c) 2025 The ZMK Contributors
# SPDX-License-Identifier: MIT

config SHIELD_lux_ergo
  def_bool $(shields_list_contains,lux_ergo)
```

## boards/shields/lux_ergo/Kconfig.shield
```kconfig
# Copyright (c) 2025 The ZMK Contributors
# SPDX-License-Identifier: MIT

config SHIELD_LUX_ERGO
  def_bool $(shields_list_contains,lux_ergo)
```
